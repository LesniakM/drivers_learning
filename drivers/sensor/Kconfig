## drivers/sensor/Kconfig
```kconfig
# Copyright (c) 2021 Nordic Semiconductor ASA
# SPDX-License-Identifier: Apache-2.0

if SENSOR
rsource "custom_mpu6050/Kconfig"
endif # SENSOR 
```

## drivers/sensor/custom_mpu6050/Kconfig
```kconfig
# Copyright (c) 2021 Nordic Semiconductor ASA
# SPDX-License-Identifier: Apache-2.0

config CUSTOM_MPU6050
    bool "Custom MPU6050 sensor"
    default y
    select I2C
    depends on SENSOR
    help
      Enable custom MPU6050 driver
```
